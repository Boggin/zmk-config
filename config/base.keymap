#include <behaviors.dtsi>
#include <dt-bindings/zmk/keys.h>
#include <dt-bindings/zmk/bt.h>
#include <dt-bindings/zmk/outputs.h>

#include "zmk-helpers/helper.h"

#define DEF 0
#define NUM 1
#define NAV 2
#define FUN 3
#define MOUSE 4
#define QWERTY 5

#include "combos.dtsi"  // requires layer aliases
#include "mouse.dtsi"
#include "extra_keys.h"

#define BT0 BT_SEL 0
#define BT1 BT_SEL 1
#define BT2 BT_SEL 2
#define BT3 BT_SEL 3
#define BT4 BT_SEL 4

#define XXX &none
#define ___ &trans

/* Global settings */

#define QUICK_TAP_MS 175

&sk {  // sticky-key config
    release-after-ms = <900>;  // release after 0.9s
    quick-release;             // no double capitalization when rolling keys
};

&sl {  // sticky-layer config
    ignore-modifiers;   // allow chording sticky mods & layers
};

&lt {  // layer-tap config
    flavor = "balanced";
    tapping-term-ms = <200>;
    quick-tap-ms = <QUICK_TAP_MS>;
};

/* Homerow mods */
#define KEYS_L LT0 LT1 LT2 LT3 LT4 LT5 LM0 LM1 LM2 LM3 LM4 LM5 LB0 LB1 LB2 LB3 LB4 LB5 // left hand
#define KEYS_R RT0 RT1 RT2 RT3 RT4 RT5 RM0 RM1 RM2 RM3 RM4 RM5 RB0 RB1 RB2 RB3 RB4 RB5 // right hand
#define THUMBS LH2 LH1 LH0 RH0 RH1 RH2                                                 // thumbs

#define MAKE_HRM(NAME, HOLD, TAP, TRIGGER_POS) \
    ZMK_HOLD_TAP(NAME, \
        flavor = "balanced"; \
        tapping-term-ms = <280>; \
        quick-tap-ms = <QUICK_TAP_MS>; \
        require-prior-idle-ms = <260>; \
        bindings = <HOLD>, <TAP>; \
        hold-trigger-key-positions = <TRIGGER_POS>; \
        hold-trigger-on-release; \
    )
MAKE_HRM(hml, &kp, &kp, KEYS_R THUMBS)  // left-hand HRMs
MAKE_HRM(hmr, &kp, &kp, KEYS_L THUMBS)  // right-hand HRMs
MAKE_HRM(hml_repeat, &kp, &key_repeat, KEYS_R THUMBS)  // left-hand HRM for repeat combo

/* Nav cluster */

// long-tap action on hold, short-tap action on all interrupts
#define MT_CORE \
    flavor = "tap-preferred"; \
    tapping-term-ms = <220>; \
    quick-tap-ms = <220>; \
    hold-trigger-key-positions = <0>;

&mt { MT_CORE };
ZMK_HOLD_TAP(mt_home, bindings = <&masked_home>, <&kp>; MT_CORE)
ZMK_HOLD_TAP(mt_end,  bindings = <&masked_end>, <&kp>; MT_CORE)

#define NAV_LEFT  &mt_home 0   LEFT    // tap: left  | long-tap: beginning of line
#define NAV_RIGHT &mt_end 0    RIGHT   // tap: right | long-tap: end       of line
#define NAV_UP    &mt LC(HOME) UP      // tap: up    | long-tap: beginning of document
#define NAV_DOWN  &mt LC(END)  DOWN    // tap: down  | long-tap: end       of document
#define NAV_BSPC  &mt LC(BSPC) BSPC    // tap: bspc  | long-tap: delete word backward
#define NAV_DEL   &mt LC(DEL)  DEL     // tap: del   | long-tap: delete word forward

// mask CTRL when holding left/right to avoid accidental jumps to beginning/end of document
#define MASK_MODS(NAME, MODS, BINDING) \
    ZMK_BEHAVIOR(NAME, mod_morph, \
        bindings = <BINDING>, <BINDING>; \
        mods = <MODS>; \
    )
MASK_MODS(masked_home, (MOD_LCTL), &kp HOME)
MASK_MODS(masked_end,  (MOD_LCTL), &kp END)

/* Custom behaviors */

// Alt+Tab swapper, requires PR #1366
ZMK_TRI_STATE(swapper,
    bindings = <&kt LALT>, <&kp TAB>, <&kt LALT>;
    ignored-key-positions = <LT2>;
)

// tap: num-word | double-tap: sticky num-layer | hold: num-layer
ZMK_TAP_DANCE(num_dance,
    tapping-term-ms = <200>;
    bindings = <&num_word>, <&sl NUM>;  // might want to reverse if rarely using more than 1 digit
)
ZMK_HOLD_TAP(num_layer_word,
    flavor = "balanced";
    tapping-term-ms = <200>;
    quick-tap-ms = <QUICK_TAP_MS>;
    bindings = <&mo>, <&num_dance>;
)
#define NUM_WORD &num_layer_word NUM 0

// tap: sticky-shift | shift + tap/ double-tap: caps-word | hold: shift
ZMK_MOD_MORPH(smart_shft,
    bindings = <&sk LSHFT>, <&caps_word>;
    mods = <(MOD_LSFT)>;
)

// tap: backspace | lshft + tap: delete | rshft + tap: shift-delete | hold: fn layer
ZMK_MOD_MORPH(bs_del,
    bindings = <&kp BSPC>, <&kp DEL>;
    mods = <(MOD_LSFT|MOD_RSFT)>;
    keep-mods = <MOD_RSFT>;
)
ZMK_HOLD_TAP(lt_bspc,
    flavor = "balanced";
    tapping-term-ms = <200>;
    quick-tap-ms = <QUICK_TAP_MS>;
    bindings = <&mo>, <&bs_del>;
)

// tap: space | shift + tap: dot -> space -> sticky shift | hold: activate layer
ZMK_MACRO(dot_spc,
    wait-ms = <0>;
    tap-ms = <5>;
    bindings = <&kp DOT &kp SPACE &sk LSHFT>;
)
ZMK_MOD_MORPH(spc_morph,
    bindings = <&kp SPACE>, <&dot_spc>;
    mods = <(MOD_LSFT|MOD_RSFT)>;
)
ZMK_HOLD_TAP(lt_spc,
    flavor = "balanced";
    tapping-term-ms = <200>;
    quick-tap-ms = <QUICK_TAP_MS>;
    bindings = <&mo>, <&spc_morph>;
)

// tap: copy | double-tap: cut
ZMK_TAP_DANCE(copy_cut,
    tapping-term-ms = <200>;
    bindings = <&kp LC(INS)>, <&kp LC(X)>;
)

// tap: comma | shift + tap: semicolon
ZMK_MOD_MORPH(comma_morph,
    bindings = <&kp COMMA>, <&kp SEMICOLON>;
    mods = <(MOD_LSFT|MOD_RSFT)>;
)

// tap: dot | shift + tap: colon
ZMK_MOD_MORPH(dot_morph,
    bindings = <&kp DOT>, <&kp COLON>;
    mods = <(MOD_LSFT|MOD_RSFT)>;
)

// tap: qmark | shift + tap: excl
ZMK_MOD_MORPH(qexcl,
    bindings = <&kp QMARK>, <&kp EXCL>;
    mods = <(MOD_LSFT|MOD_RSFT)>;
)

// misc aliases
#define CANCEL      &kp K_CANCEL             // cancel caps-word, num-word and smart-mouse

/* Caps-word, num-word and smart-mouse */

&caps_word {  // mods deactivate caps-word, requires PR #1441
    /delete-property/ ignore-modifiers;
};

&num_word {  // num-word, requires PR #1441
    layers = <NUM>;
    continue-list = <LPAR RPAR CARET STAR FSLH PLUS MINUS EQUAL DOT COMMA BSPC DEL>;
};

// mouse layer that deactivates automatically on all other keys, requires PR #1366
ZMK_TRI_STATE(smart_mouse,
    bindings = <&tog MOUSE>, <&none>, <&tog MOUSE>;
    ignored-key-positions = <LT1 LT3 KEYS_R RH0 RH1 RH2>;  // mouse keys
    ignored-layers = <MOUSE>;
)

/* Keymap */

ZMK_CONDITIONAL_LAYER(NAV NUM, FUN)  // NAV + NUM = FUN

ZMK_LAYER(base,
//╭──────╮ ╭─────────────┬─────────────┬─────────────┬─────────────┬─────────────╮ ╭──────╮ ╭─────────────┬─────────────┬─────────────┬─────────────┬─────────────╮ ╭──────╮
    X_LT     &kp Q         &kp W         &kp F         &kp P         &kp B      X_MT     &kp J         &kp L         &kp U         &kp Y      &kp SQT       X_RT
//├──────┤ ├─────────────┼─────────────┼─────────────┼─────────────┼─────────────┤ ├──────┤ ├─────────────┼─────────────┼─────────────┼─────────────┼─────────────┤ ├──────┤
    X_LM     &hml LGUI A  &hml LALT R &hml LSHFT S &hml LCTRL T      &kp G      X_MM     &kp M       &hmr LCTRL N &hmr RSHFT E  &hmr LALT I  &hmr LGUI O    X_RM
//├──────┤ ├─────────────┼─────────────┼─────────────┼─────────────┼─────────────┤ ├──────┤ ├─────────────┼─────────────┼─────────────┼─────────────┼─────────────┤ ├──────┤
    X_LB     &kp Z         &kp X         &kp C         &kp D         &kp V      X_MB     &kp K         &kp H      &comma_morph  &dot_morph   &qexcl         X_RB
//├──────┤ ╰─────────────┴─────────────┴─────────────┼─────────────┼─────────────┤ ├──────┤ ├─────────────┼─────────────┼─────────────┴─────────────┴─────────────╯ ├──────┤
    X_LH                                          &lt_spc NAV 0 &lt MOUSE TAB   X_MH     NUM_WORD     &smart_shft                                           X_RH
//╰──────╯                                         ╰─────────────┴─────────────╯ ╰──────╯ ╰─────────────┴─────────────╯                                        ╰──────╯
)

ZMK_LAYER(num,
//╭──────╮ ╭─────────────┬─────────────┬─────────────┬─────────────┬─────────────╮ ╭──────╮ ╭─────────────┬─────────────┬─────────────┬─────────────┬─────────────╮ ╭──────╮
    X_LT     &kp LBKT      &kp N7        &kp N8        &kp N9     &kp RBKT      X_MT     ___           ___           ___           ___           ___        X_RT
//├──────┤ ├─────────────┼─────────────┼─────────────┼─────────────┼─────────────┤ ├──────┤ ├─────────────┼─────────────┼─────────────┼─────────────┼─────────────┤ ├──────┤
    X_LM     &kp N0        &kp N4        &kp N5        &kp N6     &kp EQUAL     X_MM     ___           &sk LCTRL    &sk LSHFT    &sk LALT     &sk LGUI      X_RM
//├──────┤ ├─────────────┼─────────────┼─────────────┼─────────────┼─────────────┤ ├──────┤ ├─────────────┼─────────────┼─────────────┼─────────────┼─────────────┤ ├──────┤
    X_LB     &kp GRAVE     &kp N1        &kp N2        &kp N3     &kp BSLH      X_MB     ___           ___           ___           ___           ___        X_RB
//├──────┤ ╰─────────────┴─────────────┴─────────────┼─────────────┼─────────────┤ ├──────┤ ├─────────────┼─────────────┼─────────────┴─────────────┴─────────────╯ ├──────┤
    X_LH                                               ___           ___        X_MH     ___           CANCEL                                               X_RH
//╰──────╯                                        ╰─────────────┴─────────────╯ ╰──────╯ ╰─────────────┴─────────────╯                                         ╰──────╯
)

ZMK_LAYER(nav,
//╭──────╮ ╭─────────────┬─────────────┬─────────────┬─────────────┬─────────────╮ ╭──────╮ ╭─────────────┬─────────────┬─────────────┬─────────────┬─────────────╮ ╭──────╮
    X_LT     &kp ESC       ___         &kp LS(TAB)   &swapper        ___        X_MT     &to DEF      ___           ___          NAV_BSPC     NAV_DEL       X_RT
//├──────┤ ├─────────────┼─────────────┼─────────────┼─────────────┼─────────────┤ ├──────┤ ├─────────────┼─────────────┼─────────────┼─────────────┼─────────────┤ ├──────┤
    X_LM     &sk LGUI      &sk LALT    &sk LSHFT     &sk LCTRL       ___        X_MM     NAV_LEFT     NAV_DOWN      NAV_UP       NAV_RIGHT    &kp RET       X_RM
//├──────┤ ├─────────────┼─────────────┼─────────────┼─────────────┼─────────────┤ ├──────┤ ├─────────────┼─────────────┼─────────────┼─────────────┼─────────────┤ ├──────┤
    X_LB     ___           ___           ___           ___           ___        X_MB     &kp HOME     &kp PG_DN     &kp PG_UP    &kp END      &kp INS       X_RB
//├──────┤ ╰─────────────┴─────────────┴─────────────┼─────────────┼─────────────┤ ├──────┤ ├─────────────┼─────────────┼─────────────┴─────────────┴─────────────╯ ├──────┤
    X_LH                                               ___           ___        X_MH     ___           CANCEL                                               X_RH
//╰──────╯                                        ╰─────────────┴─────────────╯ ╰──────╯ ╰─────────────┴─────────────╯                                         ╰──────╯
)

ZMK_LAYER(fun,
//╭──────╮ ╭─────────────┬─────────────┬─────────────┬─────────────┬─────────────╮ ╭──────╮ ╭─────────────┬─────────────┬─────────────┬─────────────┬─────────────╮ ╭──────╮
    X_LT     &kp F12       &kp F7        &kp F8        &kp F9    &to DEF        X_MT    &bt BT_CLR   &bt BT_CLR_ALL  ___           ___          ___         X_RT
//├──────┤ ├─────────────┼─────────────┼─────────────┼─────────────┼─────────────┤ ├──────┤ ├─────────────┼─────────────┼─────────────┼─────────────┼─────────────┤ ├──────┤
    X_LM     &kp F11       &kp F4        &kp F5        &kp F6    &to QWERTY     X_MM    &out OUT_USB  &sk LCTRL    &sk LSHFT     &sk LALT     &sk LGUI      X_RM
//├──────┤ ├─────────────┼─────────────┼─────────────┼─────────────┼─────────────┤ ├──────┤ ├─────────────┼─────────────┼─────────────┼─────────────┼─────────────┤ ├──────┤
    X_LB     &kp F10       &kp F1        &kp F2        &kp F3        ___        X_MB    &out OUT_BLE  &bt BT0      &bt BT1       &bt BT2      &bt BT3       &bt BT4
//├──────┤ ╰─────────────┴─────────────┴─────────────┼─────────────┼─────────────┤ ├──────┤ ├─────────────┼─────────────┼─────────────┴─────────────┴─────────────╯ ├──────┤
    X_LH                                               ___           ___        X_MH     ___            ___                                                 X_RH
//╰──────╯                                        ╰─────────────┴─────────────╯ ╰──────╯ ╰─────────────┴─────────────╯                                         ╰──────╯
)

ZMK_LAYER(mouse,
//╭──────╮ ╭─────────────┬─────────────┬─────────────┬─────────────┬─────────────╮ ╭──────╮ ╭─────────────┬─────────────┬─────────────┬─────────────┬─────────────╮ ╭──────╮
    X_LT     ___           ___           ___           ___        &to DEF       X_MT     U_WH_L       U_WH_D       U_WH_U       U_WH_R        ___           X_RT
//├──────┤ ├─────────────┼─────────────┼─────────────┼─────────────┼─────────────┤ ├──────┤ ├─────────────┼─────────────┼─────────────┼─────────────┼─────────────┤ ├──────┤
    X_LM     &sk LGUI      &sk LALT    &sk LSHFT     &sk LCTRL       ___        X_MM     U_MS_L       U_MS_D       U_MS_U       U_MS_R        ___           X_RM
//├──────┤ ├─────────────┼─────────────┼─────────────┼─────────────┼─────────────┤ ├──────┤ ├─────────────┼─────────────┼─────────────┼─────────────┼─────────────┤ ├──────┤
    X_LB     ___           ___           ___           ___           ___        X_MB     &kp HOME     &kp PG_DN    &kp PG_UP    &kp END       &kp INS       X_RB
//├──────┤ ╰─────────────┴─────────────┴─────────────┼─────────────┼─────────────┤ ├──────┤ ├─────────────┼─────────────┼─────────────┴─────────────┴─────────────╯ ├──────┤
    X_LH                                               ___           ___        X_MH     &mkp RCLK    &mkp LCLK                                             X_RH
//╰──────╯                                        ╰─────────────┴─────────────╯ ╰──────╯ ╰─────────────┴─────────────╯                                         ╰──────╯
)

ZMK_LAYER(qwerty,
//╭──────╮ ╭─────────────┬─────────────┬─────────────┬─────────────┬─────────────╮ ╭──────╮ ╭─────────────┬─────────────┬─────────────┬─────────────┬─────────────╮ ╭──────╮
    X_LT     &kp Q         &kp W         &kp E         &kp R         &kp T      X_MT     &kp Y         &kp U         &kp I         &kp O      &kp P         &kp LBKT
//├──────┤ ├─────────────┼─────────────┼─────────────┼─────────────┼─────────────┤ ├──────┤ ├─────────────┼─────────────┼─────────────┼─────────────┼─────────────┤ ├──────┤
    X_LM     &kp A         &kp S         &kp D         &kp F         &kp G      X_MM     &kp H         &kp J         &kp K         &kp L    &kp SEMICOLON   &kp SQT
//├──────┤ ├─────────────┼─────────────┼─────────────┼─────────────┼─────────────┤ ├──────┤ ├─────────────┼─────────────┼─────────────┼─────────────┼─────────────┤ ├──────┤
    X_LB     &kp Z         &kp X         &kp C         &kp V         &kp B      X_MB     &kp N         &kp M       &kp COMMA       &kp DOT    &kp FSLH      &to DEF
//├──────┤ ╰─────────────┴─────────────┴─────────────┼─────────────┼─────────────┤ ├──────┤ ├─────────────┼─────────────┼─────────────┴─────────────┴─────────────╯ ├──────┤
    X_LH                                            &kp SPACE    &kp TAB        X_MH     &kp RET       &sk LSHFT                                            &kp BSPC
//╰──────╯                                        ╰─────────────┴─────────────╯ ╰──────╯ ╰─────────────┴─────────────╯                                         ╰──────╯
)

/* vim: set ft=c tw=174: */
