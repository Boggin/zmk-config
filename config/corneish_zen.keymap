/* source key position labels */
#include "zmk-helpers/key-labels/42.h"

#define MEH(key) LA(LS(LC(key)))
#define HYP(key) LG(LA(LS(LC(key))))

/* map Zen's extra keys */
#define X_LH  &kp ESC       // thumb row, left
#define X_RH  &bs_del       // thumb row, right
#define X_LT  &kp MEH(Q)    // toggle mic+cam
#define X_LM  &kp MEH(A)    // toggle mic
#define X_LB  &mo QWERTY    // toggle QWERTY
#define X_RT  &to NAV       // toggle NAV
#define X_RM  &kp MEH(O)    // toggle cam
#define X_RB  &to MOUSE     // toggle MOUSE

/* activate bluetooth */
#define CONFIG_WIRELESS 1

/* source the main keymap */
#include "base.keymap"

/* use 6-column layout for Zen */
/ { chosen { zmk,matrix_transform = &default_transform; }; };
